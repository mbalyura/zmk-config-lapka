#include "lapka.dtsi"

&lapka_transform {
	col-offset = <18>;
};

&default_kscan {
	input-gpios
		= <&pro_micro  2 (GPIO_ACTIVE_LOW | GPIO_PULL_UP)> // Y  // J
		, <&pro_micro  5 (GPIO_ACTIVE_LOW | GPIO_PULL_UP)> // U  // L
		, <&pro_micro  7 (GPIO_ACTIVE_LOW | GPIO_PULL_UP)> // I  // U
		, <&pro_micro  8 (GPIO_ACTIVE_LOW | GPIO_PULL_UP)> // O  // Y
		, <&pro_micro  1 (GPIO_ACTIVE_LOW | GPIO_PULL_UP)> // P  // ;

		, <&pro_micro  3 (GPIO_ACTIVE_LOW | GPIO_PULL_UP)> // H  // H
		, <&pro_micro  4 (GPIO_ACTIVE_LOW | GPIO_PULL_UP)> // J  // N
		, <&pro_micro  6 (GPIO_ACTIVE_LOW | GPIO_PULL_UP)> // K  // E
		, <&pro_micro  9 (GPIO_ACTIVE_LOW | GPIO_PULL_UP)> // L  // I
		, <&pro_micro 21 (GPIO_ACTIVE_LOW | GPIO_PULL_UP)> // ~  // O

		, <&pro_micro 15 (GPIO_ACTIVE_LOW | GPIO_PULL_UP)> // N  // K
		, <&pro_micro 19 (GPIO_ACTIVE_LOW | GPIO_PULL_UP)> // M  // M
		, <&pro_micro 10 (GPIO_ACTIVE_LOW | GPIO_PULL_UP)> // &  // ,
		, <&pro_micro 20 (GPIO_ACTIVE_LOW | GPIO_PULL_UP)> // [  // .
		, <&pro_micro  0 (GPIO_ACTIVE_LOW | GPIO_PULL_UP)> // ]  // /

		, <&pro_micro 18 (GPIO_ACTIVE_LOW | GPIO_PULL_UP)> // T1
		, <&pro_micro 14 (GPIO_ACTIVE_LOW | GPIO_PULL_UP)> // T2
		, <&pro_micro 16 (GPIO_ACTIVE_LOW | GPIO_PULL_UP)> // T3
		;
};
