#include <dt-bindings/zmk/matrix_transform.h>
#include "lapka-layouts.dtsi"
#include "lapka-transform.dtsi"
#include "lapka-kscan.dtsi"

/ {
	chosen {
		zmk,physical-layout = &lapka_pncateho_layout;
		zmk,kscan = &default_kscan;
	};
};
