## boards/shields/lapka/Kconfig.defconfig
```kconfig
if SHIELD_LAPKA_DONGLE || SHIELD_LAPKA_LEFT_CENTRAL

config ZMK_SPLIT
    default y

config ZMK_SPLIT_ROLE_CENTRAL
    default y

config ZMK_USB
    default y

config ZMK_SPLIT_BLE_CENTRAL_BATTERY_LEVEL_FETCHING
    default y

config ZMK_STUDIO
    default y

endif


if SHIELD_LAPKA_DONGLE

config ZMK_KEYBOARD_NAME
    default "Lapka Dongle"

config ZMK_SPLIT_BLE_CENTRAL_PERIPHERALS
    default 2

config BT_MAX_CONN
    default 7

config BT_MAX_PAIRED
    default 7

config BT_BAS
    default n

config ZMK_SLEEP
    default n

endif


if SHIELD_LAPKA_LEFT_CENTRAL

config ZMK_KEYBOARD_NAME
    default "Lapka"

config ZMK_SPLIT_BLE_CENTRAL_PERIPHERALS
    default 1

config BT_MAX_CONN
    default 6

config BT_MAX_PAIRED
    default 6

config ZMK_SPLIT_BLE_CENTRAL_BATTERY_LEVEL_PROXY
    default y

endif


if SHIELD_LAPKA_LEFT_PERIPHERAL || SHIELD_LAPKA_RIGHT_PERIPHERAL

config ZMK_SPLIT
    default y

endif

config ZMK_BLE
    default y
```

## boards/shields/lapka/Kconfig.shield
```kconfig
config SHIELD_LAPKA_DONGLE
	def_bool $(shields_list_contains,lapka_dongle)

config SHIELD_LAPKA_DONGLE_PNCATEHO
	def_bool $(shields_list_contains,lapka_dongle_pncateho)

config SHIELD_LAPKA_LEFT_CENTRAL
	def_bool $(shields_list_contains,lapka_left_central)

config SHIELD_LAPKA_LEFT_PERIPHERAL
	def_bool $(shields_list_contains,lapka_left_peripheral)

config SHIELD_LAPKA_RIGHT_PERIPHERAL
	def_bool $(shields_list_contains,lapka_right_peripheral)
```
