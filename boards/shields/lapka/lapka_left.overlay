#include "lapka.dtsi"

&default_kscan {
	input-gpios
		= <&pro_micro 1  (GPIO_ACTIVE_LOW | GPIO_PULL_UP)> // Q  // Q
		, <&pro_micro 16 (GPIO_ACTIVE_LOW | GPIO_PULL_UP)> // W  // W
		, <&pro_micro 14 (GPIO_ACTIVE_LOW | GPIO_PULL_UP)> // E  // F
		, <&pro_micro 18 (GPIO_ACTIVE_LOW | GPIO_PULL_UP)> // R  // P
		, <&pro_micro 21 (GPIO_ACTIVE_LOW | GPIO_PULL_UP)> // T  // G

		, <&pro_micro 2  (GPIO_ACTIVE_LOW | GPIO_PULL_UP)> // A  // A
		, <&pro_micro 10 (GPIO_ACTIVE_LOW | GPIO_PULL_UP)> // S  // R
		, <&pro_micro 15 (GPIO_ACTIVE_LOW | GPIO_PULL_UP)> // D  // S
		, <&pro_micro 19 (GPIO_ACTIVE_LOW | GPIO_PULL_UP)> // F  // T
		, <&pro_micro 20 (GPIO_ACTIVE_LOW | GPIO_PULL_UP)> // G  // D

		, <&pro_micro 0  (GPIO_ACTIVE_LOW | GPIO_PULL_UP)> // Z  // Z
		, <&pro_micro 3  (GPIO_ACTIVE_LOW | GPIO_PULL_UP)> // X  // X
		, <&pro_micro 9  (GPIO_ACTIVE_LOW | GPIO_PULL_UP)> // C  // C
		, <&pro_micro 4  (GPIO_ACTIVE_LOW | GPIO_PULL_UP)> // V  // V
		, <&pro_micro 6  (GPIO_ACTIVE_LOW | GPIO_PULL_UP)> // B  // B

		, <&pro_micro 8  (GPIO_ACTIVE_LOW | GPIO_PULL_UP)> // T1
		, <&pro_micro 7  (GPIO_ACTIVE_LOW | GPIO_PULL_UP)> // T2
		, <&pro_micro 5  (GPIO_ACTIVE_LOW | GPIO_PULL_UP)> // T3
		;
};
